## boards/shields/36_xiao_ble/Kconfig.defconfig
```kconfig
if SHIELD_36_XIAO_BLE_LEFT 

config ZMK_KEYBOARD_NAME
    default "36 Key Xiao BLE"

config ZMK_SPLIT_ROLE_CENTRAL
    default y

config ZMK_STUDIO
    default y

config CONFIG_ZMK_SLEEP
    default y

endif

if SHIELD_36_XIAO_BLE_LEFT || SHIELD_36_XIAO_BLE_RIGHT

config ZMK_SPLIT
    default y

endif
```

## boards/shields/36_xiao_ble/Kconfig.shield
```kconfig
config SHIELD_36_XIAO_BLE_LEFT
    def_bool $(shields_list_contains,36_xiao_ble_left)

config SHIELD_36_XIAO_BLE_RIGHT
    def_bool $(shields_list_contains,36_xiao_ble_right)
```
